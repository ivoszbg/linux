// SPDX-License-Identifier: BSD-3-Clause
/*
 * Copyright (c) 2021, Ivaylo Ivanov <ivo.ivanov@null.net>
 * Copyright (c) 2021, Konrad Dybcio <konrad.dybcio@somainline.org>
 */
/dts-v1/;

#include "qcom-msm8212.dtsi"

/ {
	model = "Microsoft Lumia 535";
	compatible = "microsoft,chakra","qcom,msm8212";
};

&sdhc_1 {
		status = "ok";
};

